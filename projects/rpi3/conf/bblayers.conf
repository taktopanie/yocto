## projects/rpi3/conf/bblayers.conf
```bitbake
# POKY_BBLAYERS_CONF_VERSION is increased each time build/conf/bblayers.conf
# changes incompatibly
POKY_BBLAYERS_CONF_VERSION = "2"

BBPATH = "${TOPDIR}"
BBFILES ?= ""

BBLAYERS ?= " \
  /home/maciej/Desktop/moje/programming/RPi/yocto/poky/meta \
  /home/maciej/Desktop/moje/programming/RPi/yocto/poky/meta-poky \
  /home/maciej/Desktop/moje/programming/RPi/yocto/poky/meta-yocto-bsp \
  /home/maciej/Desktop/moje/programming/RPi/yocto/meta-raspberrypi \
  /home/maciej/Desktop/moje/programming/RPi/yocto/meta-openembedded/meta-oe \
  /home/maciej/Desktop/moje/programming/RPi/yocto/meta-openembedded/meta-multimedia \
  /home/maciej/Desktop/moje/programming/RPi/yocto/meta-openembedded/meta-networking \
  /home/maciej/Desktop/moje/programming/RPi/yocto/meta-openembedded/meta-python \
  /home/maciej/Desktop/moje/programming/RPi/yocto/meta-my_layer \
  /home/maciej/Desktop/moje/programming/RPi/yocto/meta-qt6 \
  "
```
